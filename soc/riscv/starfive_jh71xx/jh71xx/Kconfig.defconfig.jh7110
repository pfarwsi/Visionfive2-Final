## soc/riscv/starfive_jh71xx/jh71xx/Kconfig.defconfig.jh7110
```kconfig
# Copyright (c) 2024 Nordic Semiconductor ASA
# SPDX-License-Identifier: Apache-2.0

config SOC
	default "jh7110" if SOC_JH7110
```
